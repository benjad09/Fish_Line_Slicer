## custom_drivers/dts/bindings/fish_items/A4988.yaml
```yaml
description: |
    a4988 stepper driver

compatible: "stepper,afour"

include: base.yaml

properties:
    step-gpios:
      type: phandle-array
      required: true
      description: |
        the gpios that define the column of a keypad
    dir-gpios:
      type: phandle-array
      required: true
      description: |
        the gpios that define the rows of a keypad
    en-gpios:
      type: phandle-array
      required: true
      description: |
        the gpios that define the column of a keypad
```

## custom_drivers/dts/bindings/fish_items/HD44780UI2C.yaml
```yaml
description: |
    describes the HD4478UI2C

compatible: "lcd,hd4478ui2c"

#include: [i2c-device.yaml, base.yaml]
include: i2c-device.yaml

properties:
    lcd_rows:
      type: int
      required: false
      default: 4
      description: |
        how many lcd rows

    lcd_cols:
      type: int
      required: false
      default: 20
      description: |
        how many lec lines
```

## custom_drivers/dts/bindings/fish_items/keypad.yaml
```yaml
description: |
    defines a keypad button 0 is row 0 col 0 ect..

compatible: "buttons,keypad"

include: base.yaml

properties:
    column-gpios:
      type: phandle-array
      required: true
      description: |
        the gpios that define the column of a keypad
    rows-gpios:
      type: phandle-array
      required: true
      description: |
        the gpios that define the rows of a keypad
```

## custom_drivers/dts/bindings/fish_items/servo.yaml
```yaml
description: |
    congragulations zephyr you broke me SO Ill jump through your dumb hoops but in the end I win

compatible: "servo,pwm"

include: base.yaml

properties:
    pwms:
      type: phandle-array
      required: true
      description: |
        the pwm instance the servo is connected to

    pulse_width_us:
      type: int
      required: false
      default: 20000
      description: |
        the standard pusle length to run the servo at

    pulse_width_min_us:
      type: int
      required: false
      default: 544
      description: |
        how long the pules that corisponds to 0 degrees is

    pulse_width_max_us:
      type: int
      required: false
      default: 2400
      description: |
        how long the pules that corisponds to 180 degrees is
```

## custom_drivers/zephyr/Kconfig
```kconfig
config CUSTOM_DRIVERS
	bool "enable custom drivers"
	depends on APPLICATION_DEFINED_SYSCALL && !USERSPACE
	help
		This Function enables all of phase one drivers ensures that config is setup to build them correctly


rsource "buttons/Kconfig"
rsource "lcd/Kconfig"
rsource "servo/Kconfig"
rsource "stepper/Kconfig"
```

## custom_drivers/zephyr/buttons/Kconfig
```kconfig
config P1_BUTTONS
	bool "Include Drivers for odl blind modules"
	depends on P1_DRIVERS
	help
	  Include Drivers for odl blind modules

config P1_KEYPAD
	bool "Include Drivers for odl blind modules"
	depends on P1_BUTTONS
	help
	  Include Drivers for odl blind modules
```

## custom_drivers/zephyr/lcd/Kconfig
```kconfig
config CUSTOM_LCD
	bool "include drivers for custom lcds"
	depends on CUSTOM_DRIVERS
	help
	  Include Drivers for odl blind modules

config CUSTOM_HD44780
	bool "include drivers for custom lcd with a I2C HD44780"
	depends on CUSTOM_LCD && I2C
	help
	  Include Drivers for odl blind modules
```

## custom_drivers/zephyr/servo/Kconfig
```kconfig
config SERVO
	bool "Include Drivers for odl blind modules"
	depends on CUSTOM_DRIVERS && PWM
	help
	  Include Drivers for odl blind modules
```

## custom_drivers/zephyr/stepper/Kconfig
```kconfig
config STEPPER
	bool "Include Drivers for odl blind modules"
	depends on CUSTOM_DRIVERS && GPIO
	help
	  Include Drivers for odl blind modules
```
